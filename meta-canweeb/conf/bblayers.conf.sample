## meta-canweeb/conf/layer.conf
```bitbake
# meta-canweeb layer configuration

BBPATH .= ":${LAYERDIR}"
BBFILES += "${LAYERDIR}/recipes-*/*/*.bb \
            ${LAYERDIR}/recipes-*/*/*.bbappend"

BBFILE_COLLECTIONS += "canweeb"
BBFILE_PATTERN_canweeb = "^${LAYERDIR}/"
BBFILE_PRIORITY_canweeb = "10"

LAYERVERSION_canweeb = "1"
LAYERSERIES_COMPAT_canweeb = "scarthgap"

LAYERDEPENDS_canweeb = "core raspberrypi"
```
